## zero/meta-mcp2517fd/conf/layer.conf
```bitbake
# We have a conf and classes directory, add to BBPATH
BBPATH .= ":${LAYERDIR}"

# We have recipes-* directories, add to BBFILES
BBFILES += "${LAYERDIR}/recipes-*/*/*.bb \
            ${LAYERDIR}/recipes-*/*/*.bbappend"

BBFILE_COLLECTIONS += "meta-mcp2517fd"
BBFILE_PATTERN_meta-mcp2517fd = "^${LAYERDIR}/"
BBFILE_PRIORITY_meta-mcp2517fd = "6"

LAYERDEPENDS_meta-mcp2517fd = "core"
LAYERSERIES_COMPAT_meta-mcp2517fd = "kirkstone"
```
